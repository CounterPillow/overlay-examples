/* SPDX-License-Identifier: MIT */

/* This example overlay describes a INA226 power sensor connected to the
 * ROCKPro64's I2C pins on its pin header. The sensor uses a 0.1 Ohm
 * shunt resistor.
 */

/dts-v1/;
/plugin/;	/* Identifies this as an overlay */

&i2c8 {		/* We are modifying the i2c8 node of the base tree */
	/* The next two are already set in the base tree we're overlaying onto,
	 * but dtc doesn't know this, so it emits warnings. Either way, they
	 * describe what the meaning of all the children's reg properties is. In
	 * this case, that the only cell in reg describes what address the device
	 * listens on.
	 */
	#address-cells = <1>;
	#size-cells = <0>;
	status = "okay";			/* Enable the I2C node of rk3399.dtsi */

	example_sensor: power-sensor@40 {	/* New power sensor with label example-sensor, address 0x40 */
		compatible = "ti,ina226";	/* Identifier for kernel to know what driver to load */
		reg = <0x40>;			/* I2C bus address, hexadecimal 0x40. You can find this in the */
						/* data sheet, and it's configurable with some address pins */
		shunt-resistor = <100000>;	/* Shunt resistor value in microohms */
	};
};
