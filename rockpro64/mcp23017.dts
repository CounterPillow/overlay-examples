/* SPDX-License-Identifier: MIT */

/* This example overlay describes a MCP23017 GPIO extender connected to the
 * ROCKPro64's I2C pins on its pin header.
 */

/dts-v1/;
/plugin/;			/* Identifies this as an overlay */

&i2c8 {				/* We are modifying the i2c8 node of the base tree */
	/* The next two are already set in the base tree we're overlaying onto,
	 * but dtc doesn't know this, so it emits warnings. Either way, they
	 * describe what the meaning of all the children's reg properties is. In
	 * this case, that the only cell in reg describes what address the device
	 * listens on.
	 */
	#address-cells = <1>;
	#size-cells = <0>;
	status = "okay";	/* Enable the I2C node of rk3399.dtsi */

	mcp23017: mcp23017@20 {				/* New child node with label "mcp23017", I2C address 0x20 */
		compatible = "microchip,mcp23017";	/* Identifier for kernel to know what driver to load */
		reg = <0x20>;				/* Describe the I2C address as being 0x20 */
		gpio-controller;			/* Point out that this is a GPIO controller */
		#gpio-cells = <2>;			/* Required for GPIO controllers */
	};
};
